## BSP_TE0820_5EV/2024.2/petalinux/project-spec/configs/configs/Kconfig
```kconfig
mainmenu "PetaLinux System Configuration"
config SUBSYSTEM_TYPE_LINUX
        bool
        default y
        select SYSTEM_ZYNQMP

config SYSTEM_ZYNQMP
        bool "ZYNQMP Configuration"
        help
          ZYNQMP Configuration for petalinux project.
          All these config options will be in /home/sundance/Emilie_Projects/git/EMC2/BSP_TE0820_5EV/2024.2/petalinux/project-spec/configs/config

config SUBSYSTEM_VARIANT_ZYNQMPEV
        bool
        default y
        help

config SUBSYSTEM_DISTRO_PETALINUX
        bool
        default y
        help

source /home/sundance/Emilie_Projects/git/EMC2/BSP_TE0820_5EV/2024.2/petalinux/project-spec/configs/configs/Kconfig.main
```
